## drivers/Kconfig
```kconfig
# SPDX-License-Identifier: Apache-2.0


# zephyr-keep-sorted-start
source "../modules/lang/rust/drivers/sensor/Kconfig"
# zephyr-keep-sorted-stop
```

## drivers/sensor/Kconfig
```kconfig
# Rust Sensor configuration options

# SPDX-License-Identifier: Apache-2.0

menuconfig RS_SENSOR
	bool "Rust Sensor drivers"
	help
	  Include sensor drivers in system config

comment "Rust Sensor Device Drivers"

# zephyr-keep-sorted-start
source "../modules/lang/rust/drivers/sensor/ti/Kconfig"
# zephyr-keep-sorted-stop
```

## drivers/sensor/ti/Kconfig
```kconfig
# SPDX-License-Identifier: Apache-2.0

# zephyr-keep-sorted-start
source "../modules/lang/rust/drivers/sensor/ti/tmp11x_rs/Kconfig"
# zephyr-keep-sorted-stop
```

## drivers/sensor/ti/tmp108_rs/Kconfig
```kconfig
# TMP108_RS temperature sensor configuration options

# SPDX-License-Identifier: Apache-2.0

config TMP108_RS
    bool "TMP116, TMP117 and TMP119 Temperature Sensors Rust"
    default y
    depends on DT_HAS_TI_TMP108_RS_ENABLED
    select I2C
    select RUST
    select CONFIG_LOG
    select CONFIG_RUST_ALLOC
    help
      Enable driver for TMP116, TMP117 and TMP119 temperature sensors.

if TMP108_RS

module = TMP108_RS
thread_priority = 10
thread_stack_size = 1024

endif
```

## drivers/sensor/ti/tmp11x_rs/Kconfig
```kconfig
# TMP11X_RS temperature sensor configuration options

# SPDX-License-Identifier: Apache-2.0

config TMP11X_RS
    bool "TMP116, TMP117 and TMP119 Temperature Sensors Rust"
    default y
    depends on DT_HAS_TI_TMP11X_RS_ENABLED
    select I2C
    select LOG
    select RUST
    select RUST_ALLOC
    help
      Enable driver for TMP116, TMP117 and TMP119 temperature sensors.

if TMP11X_RS

module = TMP11X_RS
thread_priority = 10
thread_stack_size = 1024

endif
```

## samples/fuel_gauge/boards/mimxrt685_evk_mimxrt685s_cm33.conf
```kconfig
# Keep Zephyr tickrate consistent with embassy tickrate
CONFIG_SYS_CLOCK_TICKS_PER_SEC=10000

# RTT logging
CONFIG_LOG=y
CONFIG_LOG_BACKEND_RTT=y
CONFIG_USE_SEGGER_RTT=y
CONFIG_RTT_CONSOLE=y
CONFIG_LOG_BACKEND_UART=n

# RTT buffer configuration
CONFIG_SEGGER_RTT_BUFFER_SIZE_UP=4096
CONFIG_SEGGER_RTT_BUFFER_SIZE_DOWN=2048
CONFIG_LOG_BUFFER_SIZE=4096
CONFIG_LOG_MODE_IMMEDIATE=y

# Fuel Gauge
CONFIG_SENSOR=y
CONFIG_I2C=y
CONFIG_SENSOR_INIT_PRIORITY=90
CONFIG_FUEL_GAUGE=y
CONFIG_SBS_GAUGE_NEW_API=y
CONFIG_EMUL=y
CONFIG_EMUL_SBS_GAUGE=y
```

## samples/zephyr-odp/sample.yaml
```yaml
sample:
  description: ODP Thermal Service
  name: ODP Thermal Service
common:
  harness: console
  tags: rust
  filter: CONFIG_RUST_SUPPORTED
  platform_allow:
    - nrf52840dk/nrf52840'
    - 'mimxrt685_evk/mimxrt685s/cm33'
    - 'native_sim/native/64'
    - 'frdm_mcxa266'
tests:
  sample.rust.helloworld:
    tags: ODP
```
